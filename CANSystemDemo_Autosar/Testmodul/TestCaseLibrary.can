/*@@var:*/
variables
{
}
/*@@end*/

/*@@testfunction:StopTesterPresent():*/
testfunction StopTesterPresent ()
{
    DiagStopTesterPresent("Engine");
}
/*@@end*/

